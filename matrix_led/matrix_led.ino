#include <Arduino.h>

#define LEDARRAY_D 2
#define LEDARRAY_C 3
#define LEDARRAY_B 4
#define LEDARRAY_A 5
#define LEDARRAY_G 6
#define LEDARRAY_DI 7
#define LEDARRAY_CLK 8
#define LEDARRAY_LAT 9
#define led 13

#define CANVAS_WIDTH 64   // width of the canvas

int sc = 0;               // shift count
unsigned char display_buffer[16][CANVAS_WIDTH / 8];
const unsigned char canvas[] =
{
0x00, 0x00, 0x00, 0x00, 0x00, 0x00, 0x00, 0x00, 0x00, 0x00, 0x00, 0x00, 0x00, 0x00, 0x00, 0x00, 0x00, 0x00, 0x00, 0x00, 0x00, 0x00, 0x00, 0x00, 0x00, 0x00, 0x00, 0x00,
0x10, 0x80, 0x10, 0x20, 0x08, 0x10, 0x01, 0x00, 0x20, 0x40, 0x04, 0x00, 0x00, 0x90, 0x20, 0x40, 0x81, 0x10, 0x08, 0x28, 0x03, 0x80, 0x03, 0x80, 0x03, 0x80, 0x03, 0x80,
0x10, 0xfe, 0x7c, 0x20, 0x10, 0x10, 0x7f, 0xfe, 0x10, 0x40, 0x04, 0x00, 0x00, 0x90, 0x10, 0x40, 0x61, 0x10, 0x7f, 0x24, 0x07, 0xc0, 0x07, 0xc0, 0x07, 0xc0, 0x07, 0xc0,
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0x00, 0x00, 0x00, 0x00, 0x00, 0x00, 0x00, 0x00, 0x00, 0x00, 0x00, 0x00, 0x00, 0x00, 0x00, 0x00, 0x00, 0x00, 0x00, 0x00, 0x01, 0x00, 0x01, 0x00, 0x01, 0x00, 0x01, 0x00,
};

void setup()
{
  pinMode(LEDARRAY_D, OUTPUT); 
  pinMode(LEDARRAY_C, OUTPUT);
  pinMode(LEDARRAY_B, OUTPUT);
  pinMode(LEDARRAY_A, OUTPUT);
  pinMode(LEDARRAY_G, OUTPUT);
  pinMode(LEDARRAY_DI, OUTPUT);
  pinMode(LEDARRAY_CLK, OUTPUT);
  pinMode(LEDARRAY_LAT, OUTPUT);

  Clear_Display();
  sc = 0;
}


void loop()
{
  unsigned int i;
  
  shift_display_buffer(sc);
  for(i = 0; i < 10; i++) {     // panning speed
    Display();
  }
  sc++;
  if(sc >= (sizeof(canvas) * 8 / 16 - CANVAS_WIDTH))
    sc = 0;
}


void Clear_Display()
{
  memset(display_buffer, 0, 16 * (CANVAS_WIDTH / 8));
}

void shift_display_buffer(int sc)
{
  int w = sizeof(canvas)/16;
  int x, y;

  int bytes = sc / 8;
  short low_bits = sc % 8;
  short high_bits  = 8 - low_bits;
  short low_mask  = 0xff >> low_bits;
  short high_mask = 0xff ^ low_mask;
  
  for(y = 0; y < 16; y++) {
    for(x = 0; x < (CANVAS_WIDTH / 8); x++) {
      if(low_bits != 0) {
        display_buffer[y][x] =
          ((canvas[y * w + x + bytes    ] & low_mask ) << low_bits) |
          ((canvas[y * w + x + bytes + 1] & high_mask) >> high_bits);
      } else {
        display_buffer[y][x] = canvas[y * w + x + bytes];
      }
    }
  }
}

void Display()
{
  int i, j;

  for(i = 0; i < 16; i++) {
    digitalWrite(LEDARRAY_G, HIGH);	// Turn off LED
    for(j = (CANVAS_WIDTH/8 - 1); j >= 0; j--) {        // shift register = in reverse order
      Send(~(unsigned char)display_buffer[i][j]);
    }

    digitalWrite(LEDARRAY_LAT, HIGH);	// Latch the data line
    delayMicroseconds(1);
  
    digitalWrite(LEDARRAY_LAT, LOW);
    delayMicroseconds(1);

    Scan_Line(i);
    
    digitalWrite(LEDARRAY_G, LOW);	// Turn on LED
    
    delayMicroseconds(300);		// LED needs some time to get brighter
  } 
}

void Scan_Line(unsigned char m)
{ 
  digitalWrite(LEDARRAY_D, (m & 0x08) >> 3);
  digitalWrite(LEDARRAY_C, (m & 0x04) >> 2);
  digitalWrite(LEDARRAY_B, (m & 0x02) >> 1);
  digitalWrite(LEDARRAY_A, (m & 0x01));
}

void Send(unsigned char dat)
{
  unsigned char i;
  digitalWrite(LEDARRAY_CLK, LOW);
  delayMicroseconds(1);
  digitalWrite(LEDARRAY_LAT, LOW);
  delayMicroseconds(1);

  for(i = 0 ;i < 8 ; i++) {
    digitalWrite(LEDARRAY_DI, dat & 0x01);

    digitalWrite(LEDARRAY_CLK, HIGH);       // Raising edge
    delayMicroseconds(1);
    digitalWrite(LEDARRAY_CLK, LOW);
    delayMicroseconds(1);
    dat >>= 1;
  }     
}
